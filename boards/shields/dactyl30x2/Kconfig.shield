## boards/shields/dactyl30x2/Kconfig.shield
```kconfig
# No whitespace after the comma or in your part name!
config SHIELD_DACTYL30X2_LEFT
    def_bool $(shields_list_contains,dactyl30x2_left)

# No whitespace after the comma or in your part name!
config SHIELD_DACTYL30X2_RIGHT
    def_bool $(shields_list_contains,dactyl30x2_right)

# No whitespace after the comma or in the keyboard name!
config SHIELD_DACTYL30X2_DONGLE
    def_bool $(shields_list_contains,dactyl30x2_dongle)
```

## config/west.yml
```yaml
manifest:
  remotes:
    - name: zmkfirmware
      url-base: https://github.com/zmkfirmware
    - name: RaulHuertas
      url-base: https://github.com/RaulHuertas
  projects:
    - name: zmk
      remote: zmkfirmware
      revision: v0.3
      import: app/west.yml
    - name: zmk-rgbled-widget  # <-- new entry
      remote: RaulHuertas
      revision: v0.3  
  self:
    path: config
```
